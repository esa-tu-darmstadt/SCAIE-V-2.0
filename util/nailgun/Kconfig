## util/nailgun/Kconfig
```kconfig
mainmenu "NailGun ISAX integration config"

source "build/cores_Kconfig"
source "build/ISAX/Kconfig"
source "configs/LN_Kconfig"
source "configs/SCAIE-V_Kconfig"
source "configs/sim_Kconfig"
source "plugins/*/config/Kconfig"
source "configs/advanced_Kconfig"
```

## util/nailgun/plugins/librelane/config/Kconfig
```kconfig
config LL_ENABLE
	bool "Run LibreLane"
	default n

menu "LibreLane configuration"
	depends on LL_ENABLE
	config LL_DSE
		bool "Run DSE"
		default n
	config LL_CONFIG_TEMPLATE
		string "config template"
		default "plugins/librelane/config_templates/minimal_config.json"
	config LL_TARGET_FREQ
		int "MHz = target frequency"
		default 20
	config LL_TARGET_UTIL
		int "%   = target utilization"
		default 20
	config LL_ONLY_SYN_ISAX
		depends on !NO_ISAX_ENTRY_POINT
		bool "Only synthesize the ISAX"
		default n
endmenu
```
